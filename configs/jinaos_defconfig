## configs/jinaos_defconfig
```kconfig
BR2_aarch64=y
BR2_ARM_FPU_VFPV4=y
BR2_TOOLCHAIN_BUILDROOT=y
BR2_TARGET_GENERIC_GETTY_PORT="ttyAMA0"
BR2_PACKAGE_BUSYBOX=y
BR2_PACKAGE_BASH=y
BR2_PACKAGE_GIT=y
BR2_PACKAGE_NANO=y
BR2_PACKAGE_VIM=y
BR2_PACKAGE_IPTABLES=y
BR2_PACKAGE_ARIA2=y
BR2_PACKAGE_LIGHTDM=y
BR2_PACKAGE_LIGHTDM_GTK_GREETER=y
BR2_PACKAGE_WESTON=y
BR2_PACKAGE_WESTON_TOUCH_CALIBRATOR=y
BR2_PACKAGE_LIBINPUT=y
BR2_PACKAGE_DBUS=y
BR2_LINUX_KERNEL=y
BR2_LINUX_KERNEL_CUSTOM_VERSION=y
BR2_LINUX_KERNEL_CUSTOM_VERSION_VALUE="6.6"
BR2_LINUX_KERNEL_DEFCONFIG="defconfig"
BR2_TARGET_ROOTFS_EXT2=y
BR2_TARGET_ROOTFS_EXT2_SIZE="2G"
BR2_TARGET_ROOTFS_SQUASHFS=y
BR2_PACKAGE_DEVEL=y
BR2_PACKAGE_SWAYNC=y
BR2_PACKAGE_LIBINPUT_GESTURES=y
BR2_PACKAGE_XDOTOOL=y
BR2_PACKAGE_RUSTC=y
BR2_PACKAGE_MODEM_MANAGER=y
BR2_PACKAGE_MODEM_MANAGER_MMCLI=y
BR2_PACKAGE_PHOSH_PHONE=y
BR2_PACKAGE_FOOT=y
BR2_PACKAGE_CHEESE=y
BR2_PACKAGE_RHYTHMBOX=y
BR2_PACKAGE_VLC=y
BR2_PACKAGE_CLAWS_MAIL=y
BR2_PACKAGE_GEANY=y
BR2_PACKAGE_PCMANFM=y
BR2_PACKAGE_MOUSEPAD=y
BR2_PACKAGE_GNOME_CALCULATOR=y
BR2_PACKAGE_PYTHON3=y
BR2_PACKAGE_PYGOBJECT=y
BR2_PACKAGE_GTK3=y
BR2_PACKAGE_DBUS=y
BR2_PACKAGE_LIBDBUS=y
BR2_PACKAGE_LIBGLIB2=y
BR2_PACKAGE_LIBGUDEV=y
```

## package/jpm/Config.in
```kconfig
config BR2_PACKAGE_JPM
	bool "jpm"
	help
	  JinaOS Package Manager with resumable downloads

config BR2_PACKAGE_JPM_RESUME_CACHE
	string "Download cache directory"
	default "/var/cache/jpm"
	help
	  Where jpm stores downloaded packages
```

## package/phosh-phone/Config.in
```kconfig
config BR2_PACKAGE_PHOSH_PHONE
    bool "phosh-phone"
    depends on BR2_PACKAGE_MODEM_MANAGER
    help
      Phone components for mobile Linux.
      
      This meta-package depends on the essential programs
      needed for phone calls and SMS handling.
```
